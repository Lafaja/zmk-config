/ {
    compatible = "zmk,keyboard-shield"; // Declara este archivo como un shield (teclado) para ZMK
};

// Configuración de la matriz de teclas
&kscan0 {

// FILAS

    // Pines conectados a las filas de la matriz (GPIO1, pines 6, 7 , 13 , 15 y 2)
    row-gpios = <&gpio1 6 GPIO_ACTIVE_LOW>, <&gpio1 7 GPIO_ACTIVE_LOW>, <&gpio1 13 GPIO_ACTIVE_LOW>, <&gpio1 15 GPIO_ACTIVE_LOW>, <&gpio1 2 GPIO_ACTIVE_LOW>;

// COLUMNAS

    // Pines conectados a las columnas de la matriz (GPIO0, pines 4, 8 ,17 ,20 y 11)(GPIO1, pines 0 y 4)
    col-gpios = <&gpio0 4 GPIO_ACTIVE_LOW>, <&gpio0 8 GPIO_ACTIVE_LOW>, <&gpio0 17 GPIO_ACTIVE_LOW>, <&gpio0 20 GPIO_ACTIVE_LOW>, <&gpio0 22 GPIO_ACTIVE_LOW>, <&gpio0 24 GPIO_ACTIVE_LOW>, <&gpio1 0 GPIO_ACTIVE_LOW>, <&gpio0 11 GPIO_ACTIVE_LOW>, <&gpio1 4 GPIO_ACTIVE_LOW>;

// DIODOS

    // Dirección de los diodos en la matriz (de columna a fila)
    diode-direction = COL2ROW;
};
